/*
 * Copyright 2020 Keith & Koep GmbH
 *
 */

/dts-v1/;

// Add defines here, which control behaviour of .dtsi:
#define ETHERNET_ONLY_100MBIT       0

#include "trizeps8nano.dtsi"
#include "pconxs.dtsi"
#include "atm0700l61ct.dtsi"

/ {
	model      = "Keith & Koep GmbH pConXS V2 ATM0700L61CT i.MX8MN Trizeps8-Nano";
	compatible = "kk,trizeps8nano", "kk,trizeps8mini", "fsl,imx8mn-evk", "fsl,imx8mn";

	chosen {
		stdout-path = &uart1;
	};
};








