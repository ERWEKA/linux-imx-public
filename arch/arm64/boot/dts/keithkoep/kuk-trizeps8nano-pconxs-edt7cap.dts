/*
 * Copyright 2020 Keith & Koep GmbH
 *
 */

/dts-v1/;

// Add defines here, which control behaviour of .dtsi:
#define ETHERNET_ONLY_100MBIT       1

#include "trizeps8nano.dtsi"
#include "pconxs.dtsi"
#include "edt7cap.dtsi"

/ {
	model      = "Keith & Koep GmbH pConXS EDT7CAP i.MX8MN Trizeps8-Nano";
	compatible = "kk,trizeps8nano", "kk,trizeps8mini", "fsl,imx8mn-evk", "fsl,imx8mn";

	chosen {
		stdout-path = &uart1;
	};
};








