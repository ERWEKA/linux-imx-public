/*
 * Copyright 2020 Keith & Koep GmbH
 *
 */

/dts-v1/;

// Add defines here, which control behaviour of .dtsi:
#define ETHERNET_ONLY_100MBIT       1

#include "trizeps8.dtsi"
#include "pconxs.dtsi"
#include "edt7cap.dtsi"

/ {
	model      = "Keith & Koep GmbH pConXS EDT7CAP i.MX8MQ Trizeps8";
	compatible = "kk,trizeps8", "kk,trizeps8mini", "fsl,imx8mm-evk", "fsl,imx8mm";

	chosen {
		stdout-path = &uart1;
	};
};








