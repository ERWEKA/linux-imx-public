/*
 * Copyright 2020 Keith & Koep GmbH
 *
 */

/dts-v1/;

// Add defines here, which control behaviour of .dtsi:

#include "sbcsom.dtsi"
#include "adv7533.dtsi"

/ {
	model      = "Keith & Koep GmbH SBCSOM-HDMI i.MX8MM";
	compatible = "kk,myon2","kk,trizeps8", "kk,trizeps8mini", "fsl,imx8mm-evk", "fsl,imx8mm";

	chosen {
		stdout-path = &uart1;
	};
};








