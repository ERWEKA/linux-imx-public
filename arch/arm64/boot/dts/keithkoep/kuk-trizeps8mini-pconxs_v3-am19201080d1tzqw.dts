/*
 * Copyright 2020 Keith & Koep GmbH
 *
 */

/dts-v1/;

// Add defines here, which control behaviour of .dtsi:
#define ETHERNET_ONLY_100MBIT       0

#include "trizeps8mini.dtsi"
#include "pconxs.dtsi"
#include "am19201080d1tzqw.dtsi"

/ {
	model      = "Keith & Koep GmbH pConXS P550HVN06 i.MX8MM Trizeps8-Mini";
	compatible = "kk,trizeps8", "kk,trizeps8mini", "fsl,imx8mm-evk", "fsl,imx8mm";

	chosen {
		stdout-path = &uart1;
	};
};
